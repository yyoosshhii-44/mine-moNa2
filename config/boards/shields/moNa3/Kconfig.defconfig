## config/boards/shields/moNa3/Kconfig.defconfig
```kconfig
if SHIELD_MONA3_R

config ZMK_KEYBOARD_NAME
    default "moNa3_R"

config ZMK_SPLIT
    default y

config ZMK_SPLIT_ROLE_CENTRAL
    default y

endif

if SHIELD_MONA3_L

config ZMK_KEYBOARD_NAME
    default "moNa3_L"

config ZMK_SPLIT
    default y

endif
```

## config/boards/shields/moNa3/Kconfig.shield
```kconfig
config SHIELD_MONA3_R
    def_bool $(shields_list_contains,moNa3_R)

config SHIELD_MONA3_L
    def_bool $(shields_list_contains,moNa3_L)
```
